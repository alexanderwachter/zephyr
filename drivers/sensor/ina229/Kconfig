## drivers/sensor/ina229/Kconfig
```kconfig
# INA229 Power / Energy / Charge Monitor configuration

# Copyright (c) 2021 Alexander Wachter
# SPDX-License-Identifier: Apache-2.0

menuconfig INA229
	bool "INA229 Power/Energy/Charge Monitor"
	depends on SPI
	help
	  Enable driver for INA229 Power/Energy/Charge Monitor.

if INA229

config INA229_CONT_MODE
	bool "Enable Energy/Charge counting"
	default y
	help
	  Enable Power/Energy/Charge measurement.
	  This implies that the measurements are running in continuous mode.

config INA229_TEMP_COMP
	bool "Enable temperature compensation"
	default y
	help
	  Enable temperature compensation. This implies that the temperature
	  measurment is enabled.

endif #INA229
```

## dts/bindings/sensor/ti,ina229.yaml
```yaml
# Copyright (c) 2021 Alexander Wachter
# SPDX-License-Identifier: Apache-2.0

description: Texas Instruments INA229 Power / Energy / Charge Monitor

compatible: "ti,ina229"

include: spi-device.yaml

properties:
  adc-range-narrow:
    type: boolean
    required: false
    description: |
        Set the ADC range to 40.96mV. If false, the range is set to 163.84mV.

  vbus-ct:
    type: int
    required: false
    default: 540
    description: |
      Conversion time for the bus voltage measurement
    enum:
      - 50
      - 84
      - 150
      - 280
      - 540
      - 1052
      - 2074
      - 4120

  vshunt-ct:
    type: int
    required: false
    default: 540
    description: |
      Conversion time for the shunt voltage measurement
    enum:
      - 50
      - 84
      - 150
      - 280
      - 540
      - 1052
      - 2074
      - 4120

  temp-ct:
    type: int
    required: false
    default: 540
    description: |
      Conversion time for the temperature measurement
    enum:
      - 50
      - 84
      - 150
      - 280
      - 540
      - 1052
      - 2074
      - 4120
  
  averaging:
    type: int
    required: false
    default: 4
    description: |
      Conversion time for the temperature measurement
    enum:
      - 1
      - 4
      - 16
      - 64
      - 128
      - 256
      - 512
      - 1024

  res:
    type: int
    required: true
    description: |
      Shunt resistor value in milli-ohm

  max-current:
    type: int
    required: true
    description: |
      maximum expected current value in mA.
      Used to calculate the current LSB value.

  temp-comp:
    type: int
    required: false
    description: |
      Resistor temperature compensation coefficient value in ppm/°C @ 25°C
```

## lib/minimal_libcpp/Kconfig
```kconfig
# Copyright (c) 2021 Leica Geosystems AG
# SPDX-License-Identifier: Apache-2.0

config MINIMAL_LIB_CPP
	bool "Enable a minimal implementation of the C++ library"
	default y if !LIB_CPLUSPLUS && CPLUSPLUS
  help
    The MinimalLibCpp implements a small subset of the C++ libraray.
```

## subsys/dfu/mass_storage/Kconfig
```kconfig
# Mass Storage Firmware update

# Copyright (c) 2020 Leica Geosystems AG
# SPDX-License-Identifier: Apache-2.0

menuconfig MASS_DFU
	bool "Mass Sorage Firmware Update"
	select STREAM_FLASH
	select USB
	help
	  Enable firmware update with mass storage device.
	  The Device presents itself as a mass storage device and shows
	  a simulated FAT FS. Files written to the root are directly written to
	  the IMG slot 1.

if MASS_DFU

module = MASS_DFU
module-str = masstorage dfu
source "subsys/logging/Kconfig.template.log_config"

config MASS_DFU_BULK_EP_MPS
	int "Endpoint max packet size"
	default 64
	range 32 64
	help
	  Mass storage device class bulk endpoints size

config MASS_DFU_BLOCK_SIZE
	int "Block-Size of simulated disk"
	default 512
	help
	  This parameter is exposed trough the SCSI commands

config MASS_DFU_BYTES_PER_SECTOR
	int "Bytes per sector"
	default 512
	help
	  Defines the bytes per sector in the FAT12 partition

config MASS_DFU_MAX_FILENAME
	int "Maximum filename length"
	default 15
	range 8 255
	help
	  Defines the buffer-size for filenames.
	  The size of the buffer is this value + one for termination.

config MASS_DFU_DATE_DAY
	int "Last access day for root directory"
	default 1
	range 1 31

config MASS_DFU_DATE_MONTH
	int "Last access day for root directory"
	default 1
	range 1 12

config MASS_DFU_DATE_YEAR
	int "Last access day for root directory"
	default 2020
	range 1980 2107
endif
```

## tests/lib/minimal_libcpp/chrono/testcase.yaml
```yaml
tests:
  libmcu.MinimalLibCpp.chrono.steady_clock:
    tags: MinimalLibCpp chrono
    harness: ztest
```

## tests/lib/minimal_libcpp/condition_variable/testcase.yaml
```yaml
tests:
  libmcu.MinimalLibCpp.condition_variable:
    tags: MinimalLibCpp condition_variable
    harness: ztest
```

## tests/lib/minimal_libcpp/cxa_guard/testcase.yaml
```yaml
tests:

  libmcu.MinimalLibCpp.cxa_guard:
    tags: MinimalLibCpp cxa_guard
    harness: ztest
    platform_exclude: native_posix
```

## tests/lib/minimal_libcpp/mutex/testcase.yaml
```yaml
tests:
  libmcu.MinimalLibCpp.recursive_mutex:
    tags: MinimalLibCpp recursive_mutex
    harness: ztest
```

## tests/lib/minimal_libcpp/semaphore/testcase.yaml
```yaml
tests:
  libmcu.MinimalLibCpp.semaphore:
    tags: MinimalLibCpp semaphore
    harness: ztest
```

## tests/lib/minimal_libcpp/thread/testcase.yaml
```yaml
tests:
  libmcu.MinimalLibCpp.thread:
    tags: MinimalLibCpp thread
    harness: ztest
```
